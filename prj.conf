## CMakeLists.txt
```
cmake_minimum_required(VERSION 3.8)
project(argus_neural_interface_bridge)

if(CMAKE_COMPILER_IS_GNUCXX OR CMAKE_CXX_COMPILER_ID MATCHES "Clang")
  add_compile_options(-Wall -Wextra -Wpedantic)
endif()

find_package(ament_cmake REQUIRED)
find_package(rcl REQUIRED)
find_package(rclc REQUIRED)
find_package(std_msgs REQUIRED)

add_executable(argus_neural_interface_bridge_node src/argus_neural_interface_bridge.c)
ament_target_dependencies(argus_neural_interface_bridge_node rcl rclc std_msgs)

install(TARGETS argus_neural_interface_bridge_node
  DESTINATION lib/${PROJECT_NAME})

ament_package()
```

## prj.conf
```kconfig
CONFIG_FILE_SYSTEM=y
CONFIG_FAT_FILESYSTEM_ELM=y
CONFIG_FS_FATFS=y
CONFIG_DISK_ACCESS=y
CONFIG_DISK_DRIVERS=y
CONFIG_DISK_DRIVER_SDMMC=y
CONFIG_SDMMC_STM32=y
```

## serial-usb.conf
```kconfig
CONFIG_MAIN_STACK_SIZE=25000
CONFIG_MAIN_THREAD_PRIORITY=3

CONFIG_NEWLIB_LIBC=y
CONFIG_NEWLIB_LIBC_NANO=n
CONFIG_CPLUSPLUS=y
CONFIG_LIB_CPLUSPLUS=y
CONFIG_PTHREAD_IPC=n

CONFIG_POSIX_API=y
CONFIG_NATIVE_POSIX_TIMER=y
CONFIG_APP_LINK_WITH_POSIX_SUBSYS=y
CONFIG_POSIX_CLOCK=y

CONFIG_STDOUT_CONSOLE=y
CONFIG_USB=y
CONFIG_USB_DEVICE_STACK=y
CONFIG_USB_DEVICE_PRODUCT="Zephyr micro-ROS"
CONFIG_LOG=y
CONFIG_USB_CDC_ACM=y
CONFIG_SERIAL=y
CONFIG_UART_INTERRUPT_DRIVEN=y
CONFIG_UART_LINE_CTRL=y
CONFIG_USB_DRIVER_LOG_LEVEL_ERR=y
CONFIG_USB_DEVICE_LOG_LEVEL_ERR=y
CONFIG_USB_CDC_ACM_RINGBUF_SIZE=2048

CONFIG_FILE_SYSTEM=y
CONFIG_FAT_FILESYSTEM_ELM=y
CONFIG_FS_FATFS=y
CONFIG_DISK_ACCESS=y
CONFIG_DISK_DRIVERS=y
CONFIG_LOG=y
CONFIG_PRINTK=y
CONFIG_DISK_DRIVER_SDMMC=y
CONFIG_SDMMC_STM32=y
```

## boards/olimex_stm32_e407.overlay
```dts
/* boards/olimex_stm32_e407.overlay */

/ {
	chosen {
		/* optional, but sometimes useful for clarity */
		zephyr,flash-controller = &flash_controller;
	};
};

/*
 * Start with &sdio on STM32F4.
 * If your build says this label does not exist, switch it to &sdmmc1.
 */
&{/soc/sdio@40012c00} {
	status = "okay";
	bus-width = <4>;
	pinctrl-0 = <
		&sdio_d0_pc8
		&sdio_d1_pc9
		&sdio_d2_pc10
		&sdio_d3_pc11
		&sdio_ck_pc12
		&sdio_cmd_pd2
	>;
	pinctrl-names = "default";
};
```

## src/main.c
```c
// main.c
#include <rcl/rcl.h>
#include <rcl/error_handling.h>
#include <rclc/rclc.h>
#include <rclc/executor.h>

#include <rmw_microros/rmw_microros.h>
#include <microros_transports.h>

#include <std_msgs/msg/string.h>

#include <zephyr.h>
#include <fs/fs.h>
#include <ff.h>

#include <stdio.h>
#include <unistd.h>
#include <string.h>
#include <stdbool.h>

#define STRING_BUFFER_LEN 768
#define PUBLISH_PERIOD_MS 500
#define SD_MOUNT_POINT "/SD:"
#define SD_DATA_FILE "/SD:/neural_96.csv"
#define SD_DISK_NAME "SD"

#define RCCHECK(fn) { \
	rcl_ret_t temp_rc = fn; \
	if ((temp_rc != RCL_RET_OK)) { \
		printf("Failed status on line %d: %d. Aborting.\n", __LINE__, (int)temp_rc); \
		return; \
	} \
}

#define RCSOFTCHECK(fn) { \
	rcl_ret_t temp_rc = fn; \
	if ((temp_rc != RCL_RET_OK)) { \
		printf("Failed status on line %d: %d. Continuing.\n", __LINE__, (int)temp_rc); \
	} \
}

rcl_publisher_t neural_data_publisher;
rcl_subscription_t control_subscriber;

std_msgs__msg__String incoming_control;
std_msgs__msg__String outgoing_neural_data;

bool streaming_enabled = false;

// FATFS mount state
static FATFS fat_fs;
static struct fs_mount_t sd_mount = {
	.type = FS_FATFS,
	.fs_data = &fat_fs,
	.storage_dev = (void *)SD_DISK_NAME,
	.mnt_point = SD_MOUNT_POINT,
};

static bool sd_mounted = false;

// persistent CSV stream state
static struct fs_file_t csv_file;
static bool csv_file_open = false;
static bool csv_header_skipped = false;

static bool command_equals(const std_msgs__msg__String *msg, const char *cmd) {
	size_t cmd_len = strlen(cmd);

	if (msg->data.data == NULL) {
		return false;
	}

	if (msg->data.size != cmd_len) {
		return false;
	}

	return strncmp(msg->data.data, cmd, cmd_len) == 0;
}

static void publish_text(const char *text) {
	size_t len = strlen(text);

	if (len >= outgoing_neural_data.data.capacity) {
		len = outgoing_neural_data.data.capacity - 1;
	}

	memcpy(outgoing_neural_data.data.data, text, len);
	outgoing_neural_data.data.data[len] = '\0';
	outgoing_neural_data.data.size = len;

	RCSOFTCHECK(rcl_publish(&neural_data_publisher, &outgoing_neural_data, NULL));
	printf("Published neural data: %s\n", outgoing_neural_data.data.data);
}

static int ensure_sd_mounted(void) {
	int rc;

	if (sd_mounted) {
		return 0;
	}

	rc = fs_mount(&sd_mount);
	if (rc == 0) {
		sd_mounted = true;
		printf("SD mounted at %s\n", SD_MOUNT_POINT);
		return 0;
	}

	printf("fs_mount failed: %d\n", rc);
	return rc;
}

static void close_csv_file(void) {
	if (csv_file_open) {
		fs_close(&csv_file);
		csv_file_open = false;
	}
	csv_header_skipped = false;
}

static int open_csv_file(void) {
	int rc;

	rc = ensure_sd_mounted();
	if (rc != 0) {
		return rc;
	}

	if (csv_file_open) {
		return 0;
	}

	fs_file_t_init(&csv_file);

	rc = fs_open(&csv_file, SD_DATA_FILE, FS_O_READ);
	if (rc < 0) {
		printf("fs_open failed for %s: %d\n", SD_DATA_FILE, rc);
		return rc;
	}

	csv_file_open = true;
	csv_header_skipped = false;
	printf("Opened CSV file: %s\n", SD_DATA_FILE);
	return 0;
}

static int skip_csv_header(void) {
	ssize_t bytes_read;
	char ch;

	if (!csv_file_open) {
		return -10;
	}

	if (csv_header_skipped) {
		return 0;
	}

	while (1) {
		bytes_read = fs_read(&csv_file, &ch, 1);
		if (bytes_read <= 0) {
			printf("Failed while skipping CSV header.\n");
			return -11;
		}

		if (ch == '\n') {
			csv_header_skipped = true;
			return 0;
		}
	}
}

static int rewind_csv_stream(void) {
	close_csv_file();
	return open_csv_file();
}

static int read_next_csv_line(char *buf, size_t buf_len) {
	ssize_t bytes_read;
	char ch;
	size_t idx = 0;
	bool saw_any_data = false;
	int rc;

	if (buf_len == 0) {
		return -20;
	}

	rc = open_csv_file();
	if (rc != 0) {
		return rc;
	}

	rc = skip_csv_header();
	if (rc != 0) {
		return rc;
	}

	while (1) {
		bytes_read = fs_read(&csv_file, &ch, 1);

		if (bytes_read < 0) {
			printf("fs_read failed: %d\n", (int)bytes_read);
			return (int)bytes_read;
		}

		if (bytes_read == 0) {
			// EOF
			if (saw_any_data) {
				break;
			}

			// loop back to beginning and try again
			rc = rewind_csv_stream();
			if (rc != 0) {
				return rc;
			}

			rc = skip_csv_header();
			if (rc != 0) {
				return rc;
			}

			continue;
		}

		if (ch == '\r') {
			continue;
		}

		if (ch == '\n') {
			if (saw_any_data) {
				break;
			}
			continue;
		}

		saw_any_data = true;

		if (idx < (buf_len - 1)) {
			buf[idx++] = ch;
		} else {
			buf[idx] = '\0';
			printf("CSV line too long for buffer.\n");
			return -21;
		}
	}

	buf[idx] = '\0';
	return 0;
}

void neural_data_timer_callback(rcl_timer_t *timer, int64_t last_call_time) {
	(void) last_call_time;

	if (timer == NULL || !streaming_enabled) {
		return;
	}

	char line_buf[STRING_BUFFER_LEN];
	int rc = read_next_csv_line(line_buf, sizeof(line_buf));

	if (rc == 0) {
		publish_text(line_buf);
	} else {
		snprintf(line_buf, sizeof(line_buf), "csv_read_error=%d", rc);
		publish_text(line_buf);
	}
}

void control_subscription_callback(const void *msgin) {
	const std_msgs__msg__String *msg = (const std_msgs__msg__String *)msgin;
	char line_buf[STRING_BUFFER_LEN];
	int rc;

	if (msg->data.data == NULL) {
		return;
	}

	printf("Received control command: %s\n", msg->data.data);

	if (command_equals(msg, "start")) {
		streaming_enabled = true;
		printf("Streaming enabled.\n");
	} else if (command_equals(msg, "stop")) {
		streaming_enabled = false;
		printf("Streaming disabled.\n");
	} else if (command_equals(msg, "reset")) {
		rc = rewind_csv_stream();
		if (rc == 0) {
			printf("CSV stream reset.\n");
		} else {
			printf("CSV reset failed: %d\n", rc);
		}
	} else if (command_equals(msg, "read_once")) {
		rc = read_next_csv_line(line_buf, sizeof(line_buf));
		if (rc == 0) {
			publish_text(line_buf);
		} else {
			snprintf(line_buf, sizeof(line_buf), "csv_read_error=%d", rc);
			publish_text(line_buf);
		}
	} else {
		printf("Unknown control command.\n");
	}
}

void main(void) {
	printf("main invoked\n");

	rmw_uros_set_custom_transport(
		MICRO_ROS_FRAMING_REQUIRED,
		(void *) &default_params,
		zephyr_transport_open,
		zephyr_transport_close,
		zephyr_transport_write,
		zephyr_transport_read
	);

	rcl_allocator_t allocator = rcl_get_default_allocator();
	rclc_support_t support;

	RCCHECK(rclc_support_init(&support, 0, NULL, &allocator));

	rcl_node_t node;
	RCCHECK(rclc_node_init_default(&node, "argus_neural_interface_bridge", "", &support));

	RCCHECK(rclc_publisher_init_default(
		&neural_data_publisher,
		&node,
		ROSIDL_GET_MSG_TYPE_SUPPORT(std_msgs, msg, String),
		"/argus/neural_interface_bridge/neural_data"));

	RCCHECK(rclc_subscription_init_best_effort(
		&control_subscriber,
		&node,
		ROSIDL_GET_MSG_TYPE_SUPPORT(std_msgs, msg, String),
		"/argus/neural_interface_bridge/control"));

	rcl_timer_t timer;
	RCCHECK(rclc_timer_init_default(
		&timer,
		&support,
		RCL_MS_TO_NS(PUBLISH_PERIOD_MS),
		neural_data_timer_callback));

	rclc_executor_t executor;
	RCCHECK(rclc_executor_init(&executor, &support.context, 2, &allocator));
	RCCHECK(rclc_executor_add_timer(&executor, &timer));
	RCCHECK(rclc_executor_add_subscription(
		&executor,
		&control_subscriber,
		&incoming_control,
		&control_subscription_callback,
		ON_NEW_DATA));

	static char outgoing_neural_data_buffer[STRING_BUFFER_LEN];
	outgoing_neural_data.data.data = outgoing_neural_data_buffer;
	outgoing_neural_data.data.capacity = STRING_BUFFER_LEN;
	outgoing_neural_data.data.size = 0;
	outgoing_neural_data.data.data[0] = '\0';

	static char incoming_control_buffer[STRING_BUFFER_LEN];
	incoming_control.data.data = incoming_control_buffer;
	incoming_control.data.capacity = STRING_BUFFER_LEN;
	incoming_control.data.size = 0;
	incoming_control.data.data[0] = '\0';

	printf("argus_neural_interface_bridge ready. Waiting for control commands.\n");

	while (1) {
		rclc_executor_spin_some(&executor, RCL_MS_TO_NS(100));
		usleep(100000);
	}

	close_csv_file();

	RCSOFTCHECK(rcl_publisher_fini(&neural_data_publisher, &node));
	RCSOFTCHECK(rcl_subscription_fini(&control_subscriber, &node));
	RCSOFTCHECK(rcl_node_fini(&node));
}
```

## src/argus_neural_interface_bridge.c
```c
#include <stdio.h>
#include <stdbool.h>

#include "rcl/rcl.h"
#include "rcl/error_handling.h"
#include "rclc/rclc.h"
#include "rclc/executor.h"
#include "std_msgs/msg/u_int32.h"

static std_msgs__msg__UInt32 msg;
static rcl_publisher_t pub;

static void timer_cb(rcl_timer_t *timer, int64_t last_call_time)
{
  (void) last_call_time;
  if (timer == NULL) {
    return;
  }

  msg.data++;
  rcl_ret_t rc = rcl_publish(&pub, &msg, NULL);
  if (rc != RCL_RET_OK) {
    fprintf(stderr, "publish failed: %s\n", rcl_get_error_string().str);
    rcl_reset_error();
  }
}

int main(int argc, const char *argv[]) { 
  (void) argc; (void) argv;

  rcl_allocator_t allocator = rcl_get_default_allocator();
  rclc_support_t support;
  rcl_node_t node;
  rcl_timer_t timer;
  rclc_executor_t executor;

  rcl_ret_t rc = rclc_support_init(&support, 0, NULL, &allocator);
  if (rc != RCL_RET_OK) {
    return 1;
  }

  rc = rclc_node_init_default(&node, "argus_neural_interface_bridge", "", &support);
  if (rc != RCL_RET_OK) {
    return 2;
  }

  rc = rclc_publisher_init_default(
    &pub,
    &node,
    ROSIDL_GET_MSG_TYPE_SUPPORT(std_msgs, msg, UInt32),
    "/argus/neural/interface/bridge/heartbeat");
  if (rc != RCL_RET_OK) {
    return 3; 
  }

  rc = rclc_timer_init_default(&timer, &support, RCL_MS_TO_NS(100), timer_cb);
  if (rc != RCL_RET_OK) {
    return 4;
  }

  rc = rclc_executor_init(&executor, &support.context, 1, &allocator);
  if (rc != RCL_RET_OK) {
    return 5;
  }

  rc = rclc_executor_add_timer(&executor, &timer);
  if (rc != RCL_RET_OK) {
    return 6;
  }

  msg.data = 0;

  while (true) {
    rclc_executor_spin_some(&executor, RCL_MS_TO_NS(50));
  }
  
  return 0;
}
```

## src/neural_interface_bridge_node.cpp
```c
include <rclcpp/rclcpp.hpp>

int main(int argc, char * argv[])
{
  std::cout << "Initializing Argus Neural Interface Bridge..." << std::endl;
  rclcpp::init(argc, argv);
  auto node = std::make_shared<rclcpp::Node>("neural_interface_bridge_node");
  RCLCPP_INFO(node->get_logger(), "neural_interface_bridge_node started.");
  rclcpp::spin(node);
  std::cout << "Argus Neural Interface Bridge Online." << std::endl;
  rclcpp::shutdown();
  return 0;
}
```
